## conf/bblayers.conf.sample
```bitbake
# POKY_BBLAYERS_CONF_VERSION is increased each time build/conf/bblayers.conf
# changes incompatibly
POKY_BBLAYERS_CONF_VERSION = "2"

BBPATH = "${TOPDIR}"
BBFILES ?= ""

BBLAYERS ?= " \
    ${HOME}/yocto/poky/meta \
    ${HOME}/yocto/poky/meta-poky \
    ${HOME}/yocto/meta-openembedded/meta-oe \
    ${HOME}/yocto/meta-openembedded/meta-multimedia \
    ${HOME}/yocto/meta-openembedded/meta-networking \
    ${HOME}/yocto/meta-openembedded/meta-python \
    ${HOME}/yocto/meta-raspberrypi \
    ${HOME}/yocto/yocto-meta-layer \
  "
```

## conf/layer.conf
```bitbake
# We have a conf and classes directory, append to BBPATH
BBPATH .= ":${LAYERDIR}"

# We have a recipes directory, add to BBFILES
BBFILES += "${LAYERDIR}/recipes*/*/*.bb ${LAYERDIR}/recipes*/*/*.bbappend ${LAYERDIR}/images/*.bb"

BBFILE_COLLECTIONS += "yocto-meta-layer"
BBFILE_PATTERN_yocto-meta-layer := "^${LAYERDIR}/"
BBFILE_PRIORITY_yocto-meta-layer = "8"
```
